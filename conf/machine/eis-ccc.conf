## conf/machine/eis-ccc.conf
```bitbake
#@TYPE: Machine
#@DESCRIPTION: Machine configuration for the Zynq-Miami SOM.

include conf/machine/include/zynq-extra.inc

MACHINE_FPGA_BITSTREAM ??= "fpga-image-wizard"
MACHINE_FEATURES = "ethernet serial"
DEVICETREE = "uImage-eis-ccc.dtb"

UBOOT_MACHINE = "topic_miami_config"
#UBOOT_ENTRYPOINT = "0x40000000"
#UBOOT_LOADADDRESS = "0x40000000"

KERNEL_MODULE_AUTOLOAD ?= ""
KERNEL_MODULE_AUTOLOAD += "xilinx_emacps cadence_wdt"

# UBI parameters copied from zc702 board, have to be verified
# do ubiattach /dev/ubi_ctrl -m 4
# From dmesg:
#  UBI: physical eraseblock size:   65536 bytes (64 KiB)
#  UBI: logical eraseblock size:    65408 bytes
#  UBI: smallest flash I/O unit:    1

# TODO: Fix block count for 64M flash
MKUBIFS_ARGS = "-m 1 -e 65408 -c 5200"
UBINIZE_ARGS = "-m 1 -p 64KiB"
UBI_VOLNAME = "qspi-rootfs"
```

## conf/machine/include/zynq-extra.inc
```bitbake
# The system-on-module contains flash, CPU+FPGA, RAM and various power supply
# and clock sources.
SOM_FAMILY = "eis-ccc"


# All software packages run on the ARM part, hence strip of the FPGA type from
# the machine same in order to create the MACHINE_ARCH.
MACHINE_BOARD := "${@'-'.join(d.getVar('MACHINE', True).split('-')[:-1])}"

# The kernel also only depends on the board, not the FPGA
KMACHINE = "${MACHINE_BOARD}"

# The FPGA bitstreams will use FPGA_FAMILY as their package-arch, because they
# are compatible with any FPGA of the same type, regardless of the board.
FPGA_FAMILY := "${@d.getVar('MACHINE', True).split('-')[-1:][0]}"
FPGA_FAMILY_ARCH = "${@d.getVar('FPGA_FAMILY', True).replace('-','_')}"

include conf/machine/include/zynq-base.inc

# Use hard-float ABI and allow thumb2 instructions

include conf/machine/include/tune-cortexa9.inc

MACHINEOVERRIDES =. "${SOM_FAMILY}:${MACHINE_BOARD}:${FPGA_FAMILY}:"
PACKAGE_EXTRA_ARCHS_append = " ${FPGA_FAMILY_ARCH}"
```
